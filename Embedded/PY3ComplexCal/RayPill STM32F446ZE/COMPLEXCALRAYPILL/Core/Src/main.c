/*
 * A3 CS
 * A4 DC
 * A5 SCK
 * A6 RES
 * A7 MOSI
 * */
#include "conf.h"
#include "stm32f4xx_hal.h"
#include "tecmat4x4.h"
#include <stdlib.h>

/* USER CODE BEGIN Includes */
/* vim: set ai et ts=4 sw=4: */
#include <string.h>
#include "st7735.h"
#include "fonts.h"
//#include "testimg.h"

//Matrix size 
uint8_t matSize;

// Buffer 
#define BUFFER_SIZE 16
uint8_t index = 0;
char buffer[BUFFER_SIZE];

/* USER CODE BEGIN PV */
static const uint16_t TestImage [] ={
    0xFF,0xFF,0x3,0x3,0x3,0x3,0x3,0x3,0x3,0x3,0x3,0x3,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0x0
};

/* USER CODE END PV */

/* Private function prototypes -----------------------------------------------*/

uint8_t readPad(void);

void init() {
    ST7735_Init();

    //const char ready[] = "Ready!\r\n";
    //HAL_UART_Transmit(&huart2, (uint8_t*)ready, sizeof(ready)-1, HAL_MAX_DELAY);
}

int main(void)
{
  HAL_Init();
  SystemClock_Config();
  MX_GPIO_Init();
  MX_SPI1_Init();
  confRCC();
  confGPIO();
  init();
  ST7735_FillScreen(ST7735_BLACK);

  uint8_t level = 0 ;
  char *keypress = NULL;
  char *endptr;           
  while (1){


  /*Pantallas
  0 -> Ingreso tamano sistema
  1 -> Ingreso coeficientes
  2 -> Resultados
  */
  switch (level){
    case 0:
      //ST7735_WriteString(0, 0, "INGRESA EL TAMANO DEL SISTEMA:", Font_7x10, ST7735_WHITE, ST7735_BLACK);
    	while (!readPad());
      matSize = (uint8_t)strtol(buffer, &endptr, 10);
      //Conversion exitosa
      level++;
      if ((endptr == buffer) || (matSize == 0)) {
        // Nigun numero ha sido presionado 
        level = 0;
      memset(buffer, 0, sizeof(buffer)); // Clear buffer
      break;
    case 1:
      ST7735_WriteString(0, 0, "qieresemenia:", Font_7x10, ST7735_WHITE, ST7735_BLACK);
      keypress=gotKey();
      if(*keypress == '='){
        while (!readPad());
      }
      break;  
    case 2:
      ST7735_WriteString(0, 0, "yawe:", Font_7x10, ST7735_WHITE, ST7735_BLACK);

      break;  
      }
  }

if(*keypress!= 'ñ'){
  switch (*keypress){
    case '=':
      if(level<3){
        level++;
        ST7735_FillScreen(ST7735_BLACK);
      }
      else if(level==2)
        level=2;
      break;
    case 'T':
      if(level>0){
        level--;
        ST7735_FillScreen(ST7735_BLACK);
      }
      else if(level==0)
        level=0;
      break;
    }}
  }
}


uint8_t readPad(void){
  char *keypress = NULL;
  keypress=gotKey();
  if(*keypress == 'ñ')
    return 0;

  switch (*keypress){
    case '=':
      return 1;
    case 'T':
      if(level>0)
        level--;
      return 1;
    default:
      if((index < BUFFER_SIZE))
        buffer[index++] = (char)keypress;
      return 0;
    }
}
